## CMakeLists.txt
```
cmake_minimum_required(VERSION 3.20.0)
find_package(Zephyr REQUIRED HINTS $ENV{ZEPHYR_BASE})
project(telos_agent)

target_sources(app PRIVATE src/main.c)
```

## prj.conf
```kconfig
CONFIG_TELOS=y
CONFIG_TELOS_SHELL=y
CONFIG_SHELL=y
CONFIG_SERIAL=y
CONFIG_CONSOLE=y
CONFIG_MAIN_STACK_SIZE=4096
```

## boards/qemu_cortex_a53.conf
```kconfig
CONFIG_NETWORKING=y
CONFIG_NET_L2_ETHERNET=y
CONFIG_NET_IPV4=y
CONFIG_NET_UDP=y
CONFIG_NET_TCP=y
CONFIG_NET_SOCKETS=y
CONFIG_NET_CONFIG_SETTINGS=y
CONFIG_NET_CONFIG_NEED_IPV4=y
CONFIG_NET_CONFIG_MY_IPV4_ADDR="10.0.2.15"
CONFIG_NET_CONFIG_MY_IPV4_NETMASK="255.255.255.0"
CONFIG_NET_CONFIG_MY_IPV4_GW="10.0.2.2"
CONFIG_TEST_RANDOM_GENERATOR=y
CONFIG_PCIE=y
CONFIG_ETH_E1000=y
CONFIG_TELOS_NETWORK=y
```

## src/main.c
```c
#include <stdio.h>

#include <telos/zephyr.h>

int main(void)
{
#if defined(CONFIG_TELOS_NETWORK)
    char network_address[64];
#endif

    if (telos_zephyr_initialize() != 0) {
        return 1;
    }
    printf("Telos Agentic Framework: %s\n", telos_zephyr_status());
    if (!telos_zephyr_run_static_scenario()) {
        printf("TELOS_SCENARIO: FAILED\n");
        return 1;
    }
    printf("TELOS_SCENARIO: PASSED\n");
    printf("%s\n", telos_zephyr_trace());
#if defined(CONFIG_TELOS_NETWORK)
    if (
        !telos_zephyr_network_wait(
            10000,
            network_address,
            sizeof(network_address)
        )
    ) {
        printf("TELOS_NETWORK: FAILED\n");
        return 1;
    }
    printf("TELOS_NETWORK: READY %s\n", network_address);
#endif
    return 0;
}
```
