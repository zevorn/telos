## platforms/zephyr/zephyr/Kconfig
```kconfig
menuconfig TELOS
    bool "Telos Agentic Framework"
    default y
    help
      Enable the Telos static runtime integration.

if TELOS

config TELOS_SHELL
    bool "Telos Shell commands"
    default y
    depends on SHELL
    help
      Expose chat, status, plugins, resources, and trace commands.

config TELOS_NETWORK
    bool "Telos Provider networking"
    default y if NETWORKING
    depends on NETWORKING
    help
      Enable the platform networking surface used by Provider Plugins.

config TELOS_NETWORK_PROBE_IPV4
    string "Telos scenario IPv4 probe endpoint"
    default "10.0.2.3"
    depends on TELOS_NETWORK && NET_IPV4 && NET_SOCKETS
    help
      IPv4 DNS endpoint used by the deterministic network scenario. QEMU
      user networking exposes its DNS service at 10.0.2.3.

endif
```

## west.yml
```yaml
manifest:
    version: "1.2"

    self:
        path: telos

    projects:
        - name: zephyr
          url: https://github.com/zephyrproject-rtos/zephyr
          revision: v4.4.0
          import: true
```
